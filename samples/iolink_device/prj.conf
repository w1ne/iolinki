## CMakeLists.txt
```
# Copyright (C) 2026 Andrii Shylenko
# SPDX-License-Identifier: GPL-3.0-or-later

cmake_minimum_required(VERSION 3.20.0)

find_package(Zephyr REQUIRED HINTS $ENV{ZEPHYR_BASE})
project(iolink_device)

target_sources(app PRIVATE src/main.c)
```

## sample.yaml
```
sample:
  name: IO-Link Device
  description: >
    Minimal IO-Link device built on the iolinki stack. Initializes the stack,
    registers application callbacks, and publishes process data each cycle.
common:
  tags: iolink fieldbus industrial
  harness: console
tests:
  sample.iolink.device.virtual:
    platform_allow:
      - native_sim
    integration_platforms:
      - native_sim
    extra_configs:
      - CONFIG_IOLINK_PHY_VIRTUAL=y
    harness_config:
      type: one_line
      regex:
        - "Starting iolinki IO-Link device sample"
  sample.iolink.device.uart:
    platform_allow:
      - nucleo_l476rg
    extra_args: CONF_FILE=prj.conf
    extra_configs:
      - CONFIG_IOLINK_PHY_UART=y
    build_only: true
```

## prj.conf
```kconfig
# Copyright (C) 2026 Andrii Shylenko
# SPDX-License-Identifier: GPL-3.0-or-later

CONFIG_IOLINKI=y

# The PHY is chosen automatically by target: the virtual PHY on native_sim/POSIX
# (host simulation) and the UART PHY on real hardware (see zephyr/Kconfig). No
# explicit CONFIG_IOLINK_PHY_* is needed here; override only to force a choice.

# A small fixed-PD M-sequence makes the device produce process data each cycle.
CONFIG_IOLINK_M_SEQ_DEFAULT_TYPE_1_1=y

CONFIG_LOG=y
CONFIG_MAIN_STACK_SIZE=4096
```

## boards/nucleo_f103rb.overlay
```dts
/*
 * Copyright (C) 2026 Andrii Shylenko
 * SPDX-License-Identifier: GPL-3.0-or-later
 *
 * Binds the iolinki UART PHY to USART1 on the nucleo_f103rb. USART2 stays the
 * Zephyr console (wired to the on-board ST-Link virtual COM port).
 */

/ {
    chosen {
        zephyr,iolink-uart = &usart1;
    };
};

&usart1 {
    status = "okay";
    current-speed = <38400>;
};
```

## boards/nucleo_l476rg.overlay
```dts
/*
 * Copyright (C) 2026 Andrii Shylenko
 * SPDX-License-Identifier: GPL-3.0-or-later
 *
 * Binds the iolinki UART PHY to USART1 on the nucleo_l476rg. USART1 is exposed
 * on the Arduino/Morpho headers, leaving USART2 free for the console/log.
 */

/ {
    chosen {
        zephyr,iolink-uart = &usart1;
    };
};

&usart1 {
    status = "okay";
    current-speed = <38400>;
};
```

## src/main.c
```c
/*
 * Copyright (C) 2026 Andrii Shylenko
 * SPDX-License-Identifier: GPL-3.0-or-later
 *
 * This file is part of iolinki.
 * See LICENSE for details.
 *
 * Minimal IO-Link device sample.
 *
 * The device:
 *   - selects a PHY (UART on real hardware, Virtual on native_sim),
 *   - initializes the stack with a small fixed-PD configuration,
 *   - registers application lifecycle and process-data callbacks,
 *   - publishes a 2-byte input process-data word every cycle,
 *   - services the stack from the main loop via iolink_device_process().
 */

#include <zephyr/kernel.h>
#include <zephyr/logging/log.h>
#include <string.h>

#include "iolinki/device.h"

#ifdef CONFIG_IOLINK_PHY_UART
#include "platform/zephyr/phy_uart.h"
#else
#include "iolinki/phy_virtual.h"
#endif

LOG_MODULE_REGISTER(iolink_device_sample, LOG_LEVEL_INF);

#define SAMPLE_PD_IN_LEN 2
#define SAMPLE_PD_OUT_LEN 2

static void on_operate(void)
{
    LOG_INF("IO-Link link entered OPERATE");
}

static void on_pd_output(uint8_t* data, uint8_t len)
{
    /* Process data received from the Master (Master -> Device). */
    if (len >= 1) {
        LOG_DBG("PD out from Master: 0x%02X", data[0]);
    }
}

static const iolink_app_callbacks_t app_callbacks = {
    .on_operate = on_operate,
    .on_pd_output = on_pd_output,
};

int main(void)
{
    LOG_INF("Starting iolinki IO-Link device sample");

    const iolink_phy_api_t* phy = NULL;

#ifdef CONFIG_IOLINK_PHY_UART
    if (iolink_phy_uart_init_default() != 0) {
        LOG_ERR("UART PHY init failed (check 'zephyr,iolink-uart' chosen node)");
        return -1;
    }
    phy = iolink_phy_uart_get();
    LOG_INF("Using UART PHY");
#else
    phy = iolink_phy_virtual_get();
    LOG_INF("Using Virtual PHY");
#endif

    iolink_config_t config;
    memset(&config, 0, sizeof(config));
    config.m_seq_type = (iolink_m_seq_type_t) CONFIG_IOLINK_M_SEQ_DEFAULT_TYPE;
    config.min_cycle_time = 20; /* 2.0 ms */
    config.pd_in_len = SAMPLE_PD_IN_LEN;
    config.pd_out_len = SAMPLE_PD_OUT_LEN;
    config.t_pd_us = 0;

    iolink_device_ctx_t ctx;
    iolink_device_config_t dev_config = {
        .phy = *phy,
        .stack = config,
        .app_callbacks = &app_callbacks,
    };

    if (iolink_device_init(&ctx, &dev_config) != 0) {
        LOG_ERR("iolink_device_init failed");
        return -1;
    }

    uint8_t counter = 0;
    uint32_t last_update = 0;

    while (1) {
        iolink_device_process(&ctx);

        uint32_t now = k_uptime_get_32();
        if (now - last_update >= 1000) {
            last_update = now;
            counter++;

            const uint8_t pd_in[SAMPLE_PD_IN_LEN] = {counter, 0xA5};
            iolink_device_pd_input_update(&ctx, pd_in, sizeof(pd_in), true);
            LOG_INF("Published PD in: 0x%02X 0x%02X", pd_in[0], pd_in[1]);
        }

        k_msleep(1);
    }

    return 0;
}
```
